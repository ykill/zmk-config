## config/boards/shields/slaps/Kconfig.defconfig
```kconfig
# Copyright (c) 2024 Mick Reed
# SPDX-License-Identifier: MIT

if SHIELD_SLAPS

config ZMK_KEYBOARD_NAME
  default "slaps"

endif
```

## config/boards/shields/slaps/boards/nice_nano.conf
```kconfig
# Copyright (c) 2024 Mick Reed
# SPDX-License-Identifier: MIT

# Needs SPI definitions from promicro

CONFIG_SPI=y
CONFIG_ZMK_STUDIO=y
```

## config/boards/shields/slaps/boards/nice_nano_nrf52840_zmk.conf
```kconfig
# Copyright (c) 2024 Mick Reed
# SPDX-License-Identifier: MIT

# Needs SPI definitions from promicro

CONFIG_SPI=y
CONFIG_NFCT_PINS_AS_GPIOS=y
```

## config/boards/shields/slaps/boards/nice_nano_v2.conf
```kconfig
# Copyright (c) 2024 Mick Reed
# SPDX-License-Identifier: MIT

# Needs SPI definitions from promicro

CONFIG_SPI=y
```

## config/boards/shields/winnie/Kconfig.defconfig
```kconfig
# Copyright (c) 2024 Mick Reed
# SPDX-License-Identifier: MIT

if SHIELD_WINNIE

config ZMK_KEYBOARD_NAME
  default "winnie"

endif
```

## config/boards/shields/winnie/Kconfig.shield
```kconfig
# Copyright (c) 2020 The ZMK Contributors
# SPDX-License-Identifier: MIT

config SHIELD_WINNIE
    def_bool $(shields_list_contains,winnie)
```

## config/boards/shields/winnifred/Kconfig.defconfig
```kconfig
# Copyright (c) 2024 Mick Reed
# SPDX-License-Identifier: MIT

if SHIELD_WINNIFRED

config ZMK_KEYBOARD_NAME
  default "winnifred"

endif
```

## config/boards/shields/winnifred/Kconfig.shield
```kconfig
# Copyright (c) 2020 The ZMK Contributors
# SPDX-License-Identifier: MIT

config SHIELD_WINNIFRED
    def_bool $(shields_list_contains,winnifred)
```
